## boards/shields/corne/Kconfig.defconfig
```kconfig
if SHIELD_CORNE_LEFT || SHIELD_CORNE_RIGHT

config ZMK_SPLIT
    default y

endif
```

## config/boards/shields/corne/Kconfig.defconfig
```kconfig
if SHIELD_CORNE_LEFT || SHIELD_CORNE_RIGHT

config ZMK_SPLIT
    default y

config ZMK_BLE_PASSKEY_ENTRY
    default n

config ZMK_BLE_CLEAR_BONDS_ON_START
    default y

endif
```
